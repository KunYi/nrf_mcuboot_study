## CMakeLists.txt
```
# CMakeLists.txt
cmake_minimum_required(VERSION 3.20.0)
find_package(Zephyr REQUIRED HINTS $ENV{ZEPHYR_BASE})

project(hello_world)

target_sources(app PRIVATE src/main.c)
```

## sysbuild.conf
```
# Enable MCUboot
SB_CONFIG_BOOTLOADER_MCUBOOT=y
```

## prj.conf
```kconfig
# 啟用 GPIO
CONFIG_GPIO=y

# nRF board library
CONFIG_DK_LIBRARY=y

# 啟用 UART
CONFIG_SERIAL=y
CONFIG_CONSOLE=y
CONFIG_UART_CONSOLE=y

# MCUboot 配置
CONFIG_BOOTLOADER_MCUBOOT=y
CONFIG_MCUBOOT_IMG_MANAGER=y
CONFIG_IMG_MANAGER=y

# Flash 配置
CONFIG_FLASH=y
CONFIG_FLASH_MAP=y
CONFIG_FLASH_PAGE_LAYOUT=y

# Partition Manager Configuration
CONFIG_PARTITION_MANAGER_ENABLED=y
CONFIG_PM_EXTERNAL_FLASH_MCUBOOT_SECONDARY=n
CONFIG_PM_SINGLE_IMAGE=y

# DFU 相關配置
CONFIG_UPDATEABLE_IMAGE_NUMBER=1
CONFIG_MCUBOOT_UPDATE_FOOTER_SIZE=0x2000

# DFU Configuration
CONFIG_DFU_TARGET=y
CONFIG_DFU_TARGET_MCUBOOT=y
CONFIG_STREAM_FLASH=y
CONFIG_STREAM_FLASH_ERASE=y
CONFIG_PM_PARTITION_SIZE_SETTINGS_STORAGE=0x4000
CONFIG_SETTINGS_FCB=y
CONFIG_SETTINGS=y
CONFIG_FCB=y

# BLE 配置
CONFIG_BT=y
CONFIG_BT_PERIPHERAL=y
CONFIG_BT_DFU_SMP=y
CONFIG_BT_DEVICE_NAME="nRF52840_DFU"

# Enable GATT and DFU-related services
CONFIG_BT_GATT_SERVICE_CHANGED=y

# Enable MCUboot and DFU support
CONFIG_MCUMGR=y
CONFIG_MCUMGR_GRP_OS_MCUMGR_PARAMS=y
#CONFIG_MCUMGR_GRP_ZBASIC=y
CONFIG_MCUMGR_GRP_IMG=y
CONFIG_MCUMGR_GRP_OS=y
CONFIG_MCUMGR_GRP_OS_INFO=y
CONFIG_MCUMGR_GRP_OS_BOOTLOADER_INFO=y
CONFIG_MCUMGR_GRP_ENUM=y
CONFIG_MCUMGR_TRANSPORT_BT=y
CONFIG_MCUMGR_TRANSPORT_BT_CONN_PARAM_CONTROL=y
CONFIG_MCUMGR_TRANSPORT_NETBUF_SIZE=2048
# Enable MCUmgr and dependencies

# Enable ZCBOR (required by MCUMGR)
CONFIG_ZCBOR=y
CONFIG_ZCBOR_CANONICAL=y

# BLE SMP 配置
CONFIG_BT_SMP=y
CONFIG_BT_PERIPHERAL=y
CONFIG_BT_L2CAP_TX_MTU=498
CONFIG_BT_BUF_ACL_RX_SIZE=502
CONFIG_BT_BUF_ACL_TX_SIZE=502

# MCUboot 簽名配置
# CONFIG_BOOT_SIGNATURE_TYPE_RSA=y
CONFIG_BOOT_SIGNATURE_KEY_FILE="bootloader/mcuboot/root-rsa-2048.pem"

# Stack and heap settings (adjust based on your application requirements)
CONFIG_MAIN_STACK_SIZE=2048
CONFIG_HEAP_MEM_POOL_SIZE=2048

# Logging and debugging
CONFIG_LOG=y
CONFIG_LOG_DEFAULT_LEVEL=3
```

## src/main.c
```c
#include <zephyr/types.h>
#include <zephyr/kernel.h>
#include <zephyr/sys/printk.h>
#include <zephyr/drivers/gpio.h>
#include <dk_buttons_and_leds.h>
#include <zephyr/bluetooth/bluetooth.h>
#include <zephyr/bluetooth/conn.h>
#include <zephyr/bluetooth/gatt.h>
#include <zephyr/mgmt/mcumgr/mgmt/mgmt.h>

#define SLEEP_TIME_MS   500
#define LED_OTA_STATUS  DK_LED1
#define LED_CON_STATUS  DK_LED2
#define LED_RUNNING     DK_LED3

static struct bt_conn *current_conn;

static const struct bt_data ad[] = {
    BT_DATA_BYTES(BT_DATA_FLAGS, (BT_LE_AD_GENERAL | BT_LE_AD_NO_BREDR)),
    BT_DATA_BYTES(BT_DATA_UUID128_ALL,
              0x84, 0xaa, 0x60, 0x74, 0x52, 0x8a, 0x8b, 0x86,
              0xd3, 0x4c, 0xb7, 0x1d, 0x1d, 0xdc, 0x53, 0x8d),
};

/* 系統狀態 */
static bool dfu_mode = false;

static void connected(struct bt_conn *conn, uint8_t err)
{
    if (err) {
        printk("Connection failed (err %u)\n", err);
        return;
    }

    printk("Connected\n");
    current_conn = bt_conn_ref(conn);
    dk_set_led_on(LED_CON_STATUS);
}

static void disconnected(struct bt_conn *conn, uint8_t reason)
{
    printk("Disconnected (reason %u)\n", reason);

    if (current_conn) {
        bt_conn_unref(current_conn);
        current_conn = NULL;
    }

    dk_set_led_off(LED_CON_STATUS);

    // 如果在 DFU 模式下斷開連接，關閉 DFU 指示燈
    if (dfu_mode) {
        dfu_mode = false;
        dk_set_led_off(LED_OTA_STATUS);
    }
}

static struct bt_conn_cb conn_callbacks = {
    .connected = connected,
    .disconnected = disconnected,
};

static void bt_ready(int err)
{
    if (err) {
        printk("Bluetooth init failed (err %d)\n", err);
        return;
    }

    printk("Bluetooth initialized\n");

    // 使用設備名稱進行廣播
    err = bt_le_adv_start(BT_LE_ADV_CONN_NAME, ad, ARRAY_SIZE(ad), NULL, 0);
    if (err) {
        printk("Advertising failed to start (err %d)\n", err);
        return;
    }

    printk("Advertising successfully started\n");
}

/* 按鈕處理函數 */
static void button_handler(uint32_t button_state, uint32_t has_changed)
{
    if (has_changed & DK_BTN1_MSK) {
        if (button_state & DK_BTN1_MSK) {
            // 切換 DFU 模式
            dfu_mode = !dfu_mode;
            printk("%s DFU mode\n", dfu_mode ? "Entering" : "Exiting");

            if (dfu_mode) {
                dk_set_led_on(LED_OTA_STATUS);
            } else {
                dk_set_led_off(LED_OTA_STATUS);
            }
        }
    }
}

int main(void)
{
    int err;
    bool led_running = false;

    printk("Starting MCUboot BLE OTA example\n");

    // Initialize LEDs and Buttons
    err = dk_leds_init();
    if (err) {
        printk("LEDs init failed (err %d)\n", err);
        return 0;
    }

    err = dk_buttons_init(button_handler);
    if (err) {
        printk("Buttons init failed (err %d)\n", err);
        return 0;
    }

    // Initialize Bluetooth
    err = bt_enable(bt_ready);
    if (err) {
        printk("Bluetooth init failed (err %d)\n", err);
        return 0;
    }

    bt_conn_cb_register(&conn_callbacks);

    // // Initialize MCUmgr
    // err = os_mgmt_register_group();
    // if (err) {
    //     printk("Failed to register OS management group (err: %d)\n", err);
    //     return 0;
    // }

    // err = img_mgmt_register_group();
    // if (err) {
    //     printk("Failed to register IMG management group (err: %d)\n", err);
    //     return 0;
    // }

    // // Initialize SMP over Bluetooth transport
    // err = mcumgr_smp_bt_register();
    // if (err) {
    //     printk("Failed to register SMP BT transport (err: %d)\n", err);
    //     return 0;
    // }

    printk("MCUboot BLE OTA example started\n");
    dk_set_led_on(LED_RUNNING);
    led_running = true;

    while (1) {
        k_msleep(SLEEP_TIME_MS);
        // 只在非 DFU 模式下閃爍運行指示燈
        if (!dfu_mode) {
            led_running = !led_running;
            (led_running) ? dk_set_led_on(LED_RUNNING) : dk_set_led_off(LED_RUNNING);
        }
    }

    return 0;
}
```
